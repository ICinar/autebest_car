;
; Example script for programming of MPC5748G (Calypso) internal flash.
;
; $Author: rweiss $
; $Date: 2013-04-23 13:38:50 +0200 (Di, 23 Apr 2013) $
; $Rev: 2230 $
;

  ; Check if script is called with parameters
  ; Valid parameters:
  ;   PREPAREONLY     : prepare flash programming without user interaction
  ;   SKIPCONFIG      : skip configuration part to allow script esternal configuration
  LOCAL &parameters &param_prepareonly &param_skipconfig
  ENTRY %LINE &parameters
  &param_prepareonly=(STRing.SCAN("&parameters","PREPAREONLY",0)!=-1)
  &param_skipconfig=(STRing.SCAN("&parameters","SKIPCONFIG",0)!=-1)

  LOCAL &DualPort
  IF VERSION.BUILD.BASE()>=43441.
    &DualPort="/DualPort"

  ;========================================================================
  ; CPU setup
  IF !&param_skipconfig
  (
    SYStem.RESet
    SYStem.BdmClock 4.0MHz
    SyStem.Option.SLOWRESET ON
    SYStem.CPU MPC5748G
    SYStem.CONFIG.CORE 1. 1.
    SYStem.CONFIG.Slave OFF
    SYStem.Option.WATCHDOG OFF
    SYStem.Up

    ; Initialize internal SRAM (only partially used)
    Data.Set EA:0x40000000--0x4000ffff %Quad 0
  )

  ;========================================================================
  ; Flash declaration

  FLASH.RESet

  FLASH.Create 1. 0x00610000--0x0061FFFF TARGET     Quad 0x0007    ; 16 KB HSM code block 2
  FLASH.Create 1. 0x00620000--0x0062FFFF TARGET     Quad 0x0009    ; 16 KB HSM code block 3
  FLASH.Create 3. 0x00F80000--0x00F83FFF TARGET     Quad 0x0200    ; HSM data block 0
  FLASH.Create 3. 0x00F84000--0x00F87FFF TARGET     Quad 0x0201    ; HSM data block 1

  ; UTEST address space
  FLASH.Create 6. 0x00400000--0x00403FFF TARGET     QUAD 0x0500    ; UTEST - OTP

  FLASH.TARGET E:0x40000000 E:0x40002000 0x1000 ~~/demo/powerpc/flash/quad/c55fm5746m.bin /STACKSIZE 0x0200 &DualPort

  ; Flash script ends here if called with parameter PREPAREONLY
  IF &param_prepareonly
    ENDDO

  ;========================================================================
  ; Flash programming

  FLASH.Program all
  ;;;;;;;;;;;;;;;;;;;;;
  ; Prog UTEST for HSM
  ;;;;;;;;;;;;;;;;;;;;; 

  ; configure HSM parallel boot (only on later SHE firmwarE)
  data.set 0x4000C8 %quad 0xFFFFFFABFFFFFFAB

  ; program HSM DCFs - ***** INSERT CORRECT ADDRESS AND UNCOMMENT THESRE LINES *****
  ;data.set 0x4003B8 %quad 0x0000000300400040
  ;data.set 0x4003C0 %quad 0x0000000800400100


  FLASH.Program off	

  ENDDO