; --------------------------------------------------------------------------------
; @Title: Internal flash programming script for MPC574xB/C/G (Calypso3M/6M).
;
; @Description:
; Script arguments:
;
;   DO mpc574xg [PREPAREONLY] [SKIPCONFIG]
;
;     PREPAREONLY only declares flash but does not execute flash programming
;     SKIPCONFIG  skip configuration part to allow script external configuration
;
; Example:
;
;   DO ~~/demo/powerpc/flash/mpc574xg PREPAREONLY SKIPCONFIG
;
; @Author: rweiss
; @Chip: MPC5744B MPC5745B MPC5746B MPC5744C MPC5745C MPC5746C
;        MPC5747C MPC5748C MPC5746G MPC5747G MPC5748G
; @Copyright: (C) 1989-2014 Lauterbach GmbH, licensed for use with TRACE32(R) only
; --------------------------------------------------------------------------------
; $Rev: 2918 $
; $Id: mpc574xg.cmm 2918 2014-07-24 14:35:28Z rweiss $
;

ENTRY &elfname

IF !OS.FILE("&elfname")
  &elfname="*"

LOCAL &DualPort
IF VERSION.BUILD.BASE()>=45520.
   &DualPort="/DualPort"

; ------------------------------------------------------------------------------
; CPU setup

SYStem.RESet
SYStem.BdmClock 4.0MHz
SyStem.Option.SLOWRESET ON
SYStem.DETECT.CPU

IF CPUIS(MPC5748G)
(
  GOTO weiterweiter
)

PRINT "this only works for MPC5748G, but CPU() returned " CPU()

ENDDO

weiterweiter:

SYStem.CONFIG.CORE 1. 1.
SYStem.CONFIG.Slave OFF
SYStem.Option.WATCHDOG OFF
SYStem.Up

; Initialize internal SRAM (only partially used)
Data.Set EA:0x40000000--0x4000ffff %Quad 0


; ------------------------------------------------------------------------------
; Flash declaration

FLASH.RESet

  ; Low address space
  FLASH.Create 1. 0x00404000--0x00407FFF NOP    Quad 0x0001 /INFO "BAF (read only)"
  FLASH.Create 1. 0x00610000--0x0061FFFF TARGET    Quad 0x0007 /INFO "HSM code"
  FLASH.Create 1. 0x00620000--0x0062FFFF TARGET    Quad 0x0009 /INFO "HSM code"
  FLASH.Create 1. 0x00F8C000--0x00F8FFFF NOP Quad 0x0000    ; 16 KB code block 0
  FLASH.Create 1. 0x00FC0000--0x00FC7FFF NOP Quad 0x0002    ; 32 KB code block 2
  FLASH.Create 1. 0x00FC8000--0x00FCFFFF NOP Quad 0x0003    ; 32 KB code block 3
  FLASH.Create 1. 0x00FD0000--0x00FD7FFF NOP Quad 0x0004    ; 32 KB code block 4
  FLASH.Create 1. 0x00FD8000--0x00FDFFFF NOP Quad 0x0005    ; 32 KB code block 5
  FLASH.Create 1. 0x00FE0000--0x00FEFFFF NOP Quad 0x0006    ; 64 KB code block 0
  FLASH.Create 1. 0x00FF0000--0x00FFFFFF NOP Quad 0x0008    ; 64 KB code block 1

  ; Mid address space
  FLASH.Create 2. 0x00F90000--0x00F93FFF NOP Quad 0x0100    ; 16 KB code block 1
  FLASH.Create 2. 0x00F94000--0x00F97FFF NOP Quad 0x0101    ; 16 KB code block 2
  FLASH.Create 2. 0x00F98000--0x00F9BFFF NOP Quad 0x0102    ; 16 KB code block 3
  FLASH.Create 2. 0x00F9C000--0x00F9FFFF NOP Quad 0x0103    ; 16 KB code block 4
  FLASH.Create 2. 0x00FA0000--0x00FA3FFF NOP Quad 0x0104    ; 16 KB code block 5
  FLASH.Create 2. 0x00FA4000--0x00FA7FFF NOP Quad 0x0105    ; 16 KB code block 6
  FLASH.Create 2. 0x00FA8000--0x00FABFFF NOP Quad 0x0106    ; 16 KB code block 7
  FLASH.Create 2. 0x00FAC000--0x00FAFFFF NOP Quad 0x0107    ; 16 KB code block 8
  FLASH.Create 2. 0x00FB0000--0x00FB7FFF NOP Quad 0x0108    ; 32 KB code block 0
  FLASH.Create 2. 0x00FB8000--0x00FBFFFF NOP Quad 0x0109    ; 32 KB code block 1

  ; High address space
  FLASH.Create 3. 0x00F80000--0x00F83FFF TARGET    Quad 0x0200 /INFO "HSM data"
  FLASH.Create 3. 0x00F84000--0x00F87FFF TARGET    Quad 0x0201 /INFO "HSM data"

  ; Large (256k) address space
  FLASH.Create 4. 0x01000000--0x0103FFFF NOP Quad 0x0300    ; 256 KB Flash block 0
  FLASH.Create 4. 0x01040000--0x0107FFFF NOP Quad 0x0301    ; 256 KB Flash block 1
  FLASH.Create 4. 0x01080000--0x010BFFFF NOP Quad 0x0302    ; 256 KB Flash block 2
  FLASH.Create 4. 0x010C0000--0x010FFFFF NOP Quad 0x0303    ; 256 KB Flash block 3
  FLASH.Create 4. 0x01100000--0x0113FFFF NOP Quad 0x0304    ; 256 KB Flash block 4
  FLASH.Create 4. 0x01140000--0x0117FFFF NOP Quad 0x0305    ; 256 KB Flash block 5
  FLASH.Create 4. 0x01180000--0x011BFFFF NOP Quad 0x0306    ; 256 KB Flash block 6
  FLASH.Create 4. 0x011C0000--0x011FFFFF NOP Quad 0x0307    ; 256 KB Flash block 7
  FLASH.Create 4. 0x01200000--0x0123FFFF NOP Quad 0x0308    ; 256 KB Flash block 8
  FLASH.Create 4. 0x01240000--0x0127FFFF NOP Quad 0x0309    ; 256 KB Flash block 9
  FLASH.Create 4. 0x01280000--0x012BFFFF NOP Quad 0x030a    ; 256 KB Flash block 10
  FLASH.Create 4. 0x012C0000--0x012FFFFF NOP Quad 0x030b    ; 256 KB Flash block 11
  FLASH.Create 4. 0x01300000--0x0133FFFF NOP Quad 0x030c    ; 256 KB Flash block 12 
  FLASH.Create 4. 0x01340000--0x0137FFFF NOP Quad 0x030d    ; 256 KB Flash block 13
  FLASH.Create 4. 0x01380000--0x013BFFFF NOP Quad 0x030e    ; 256 KB Flash block 14
  FLASH.Create 4. 0x013C0000--0x013FFFFF NOP Quad 0x030f    ; 256 KB Flash block 15
  FLASH.Create 4. 0x01400000--0x0143FFFF NOP Quad 0x0310    ; 256 KB Flash block 16
  FLASH.Create 4. 0x01440000--0x0147FFFF NOP Quad 0x0311    ; 256 KB Flash block 17
  FLASH.Create 4. 0x01480000--0x014BFFFF NOP Quad 0x0312    ; 256 KB Flash block 18
  FLASH.Create 4. 0x014C0000--0x014FFFFF NOP Quad 0x0313    ; 256 KB Flash block 19
  FLASH.Create 4. 0x01500000--0x0153FFFF NOP Quad 0x0314    ; 256 KB Flash block 20
  FLASH.Create 4. 0x01540000--0x0157FFFF NOP Quad 0x0315    ; 256 KB Flash block 21

  ; UTEST address space
  FLASH.Create 6. 0x00400000--0x00403FFF NOP Quad 0x0500 /OTP /INFO "UTEST (OTP)"

  ; Overlay enabled mapping
  FLASH.CreateALIAS 0x08A00000--0x08FFFFFF 0x00A00000   ; Small & medium flash blocks
  FLASH.CreateALIAS 0x09000000--0x09FFFFFF 0x01000000   ; Large flash blocks

  FLASH.TARGET E:0x40000000 E:0x40002000 0x1000 ~~/demo/powerpc/flash/quad/c55fm5746m.bin /STACKSIZE 0x0200 &DualPort

  ; ------------------------------------------------------------------------------
  ; Flash programming

FLASH.ReProgram ALL /Erase

;Data.LOAD.auto &elfname
Data.Load.Elf "C:/Users/tobias.latzo/repositories/hsm/hsm_apps/hsm_firmware/hsm.elf"

FLASH.ReProgram off 

ENDDO
